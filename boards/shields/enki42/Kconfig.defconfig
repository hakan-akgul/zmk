## boards/shields/enki42/Kconfig.defconfig
```kconfig
# Copyright (c) 2020 The ZMK Contributors
# SPDX-License-Identifier: MIT

if SHIELD_ARMADA_DONGLE

config ZMK_KEYBOARD_NAME
	default "armada Dongle"
	
config ZMK_SPLIT_BLE_ROLE_CENTRAL
	default y
	
config ZMK_USB
	default y

endif

if SHIELD_ARMADA_LEFT || SHIELD_ARMADA_RIGHT || SHIELD_ARMADA_DONGLE 

config ZMK_SPLIT
	default y

config ZMK_BLE
	default y
	
endif
```

## boards/shields/enki42/Kconfig.shield
```kconfig
# Copyright (c) 2020 The ZMK Contributors
# SPDX-License-Identifier: MIT

config SHIELD_ARMADA_LEFT
	def_bool $(shields_list_contains,armada_left)

config SHIELD_ARMADA_RIGHT
	def_bool $(shields_list_contains,armada_right)

config SHIELD_ARMADA_DONGLE
	def_bool $(shields_list_contains,armada_dongle)
```
